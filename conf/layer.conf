## conf/layer.conf
```bitbake
# We have a conf and classes directory, add to BBPATH
BBPATH .= ":${LAYERDIR}"

# We have recipes-* directories, add to BBFILES
BBFILES += "${LAYERDIR}/recipes-*/*/*.bb \
            ${LAYERDIR}/recipes-*/*/*.bbappend
            ${LAYERDIR}/recipes-*/*/*/*.bb  \
            "

BBFILE_COLLECTIONS += "meta-mittch-kirk"
BBFILE_PATTERN_meta-mittch-kirk = "^${LAYERDIR}/"
BBFILE_PRIORITY_meta-mittch-kirk = "6"

LAYERDEPENDS_meta-mittch-kirk = "core"
LAYERSERIES_COMPAT_meta-mittch-kirk = "kirkstone"
```
